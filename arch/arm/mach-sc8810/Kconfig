## arch/arm/mach-sc8810/Kconfig
```kconfig
if ARCH_SC8810

comment "SC8810 Board Type"

choice
	prompt "SC8810 Board"

config MACH_OPENPHONE_SC6820
       default n
       bool "6820 OpenPhone"
       help
         6820 openphone board based on SC8810.

config MACH_SP8810EA
	default n
	bool "SP8810EA Phone"
	help
	  SP8810EA phone board based on SC8810.

config MACH_SP8810EB
	default n
	bool "SP8810EB Phone"
	help
	  SP8810EB phone board based on SC8810.

config MACH_SP8810GA
	default n
	bool "SP8810GA Phone"
	help
	  SP8810GA phone board based on SC8810.

config MACH_SP6820GA
	default n
	bool "SP6820GA Phone"
	help
	  SP6820GA phone board based on SC8810.

config MACH_AMAZING
	default n
	bool "AMAZING Phone"
	help
	  AMAZING phone board based on SC8810.

config MACH_CORI2G
        default n
        bool "CORI2G Phone"
        help
          CORI2G phone board based on SC6820.

config MACH_KYLETD
	default n
	bool "KYLETD Phone"
	help
	  KYLETD phone board based on SC8810.

config MACH_VASTOI
	default n
	bool "VASTOI Phone"
	help
	  VASTOI phone board based on SC8810.

config MACH_Z788
	default n
	bool "Z788 Phone"
	help
	  Z788 phone board based on SC8810.
endchoice

config SPRD_PMEM_SIZE
        int "size for /dev/pmem"
        range 1 16
        default 8
	depends on ANDROID_PMEM

config SPRD_PMEM_ADSP_SIZE
        int "size for /dev/pmem_adsp"
        range 1 64
        default 22
	depends on ANDROID_PMEM

config SC8810_VIBRATOR
        depends on ARCH_SC8810
        select ANDROID_TIMED_OUTPUT
        default n
        bool "vibrator for SC8810"

config SS_VIBRATOR
        depends on ARCH_SC8810
        select ANDROID_TIMED_OUTPUT
        default n
        bool "SS vibrator for SC8810"

config SC8810_DDR_6G
        depends on ARCH_SC8810
        default n
        bool "SC8810 feature to use 6Gb DDR"

config BT_MGMT
	bool "Bluetooth Mgmt"
	default n
	help
	this is for bluetooth mgmt
	  
config BT_BCM4330
	bool "Enable BCM4330 driver"
	default n  
	  
endif
```
